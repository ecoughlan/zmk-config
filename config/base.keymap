/*
 * Toucan ZMK Configuration - Dvorak with urob's timeless homerow mods
 * 34-key effective layout on 42-key hardware (outer columns = &none)
 */

#include <behaviors.dtsi>
#include <behaviors/num_word.dtsi>
#include <behaviors/unicode.dtsi>
#include <zmk-helpers/helper.h>
#include <zmk-helpers/key-labels/42.h>
#include <dt-bindings/zmk/keys.h>
#include <dt-bindings/zmk/bt.h>
#include <dt-bindings/zmk/outputs.h>

#define CONFIG_WIRELESS

/* Layer definitions */
#define BASE   0
#define NAV    1
#define MOUSE  2
#define MEDIA  3
#define NUM    4
#define SYM    5
#define FUN    6
#define INTL   7
#define QWERTY 8
#define GAME   9
#define GNUM   10
#define NUMPAD 11
#define SYS    12

#define XXX &none
#define ___ &trans

/* Global defaults */
#define QUICK_TAP_MS 175

&sk {
  release-after-ms = <900>;
  quick-release;
};

&sl {
  ignore-modifiers;
};

&lt {
  flavor = "balanced";
  tapping-term-ms = <200>;
  quick-tap-ms = <QUICK_TAP_MS>;
};

/* Key position groups for HRMs
 *
 * Toucan 42-key layout (3x6+3 split):
 * ╭──────────────────────────────╮ ╭──────────────────────────────╮
 * │  0   1   2   3   4   5       │ │       6   7   8   9  10  11  │
 * │ 12  13  14  15  16  17       │ │      18  19  20  21  22  23  │
 * │ 24  25  26  27  28  29       │ │      30  31  32  33  34  35  │
 * ╰──────────────╮ 36  37  38    │ │      39  40  41 ╭────────────╯
 *                ╰───────────────╯ ╰─────────────────╯
 *
 * Using 34-key core (outer columns 0,12,24 and 11,23,35 are XXX):
 * ╭─────────────────────────────╮ ╭─────────────────────────────╮
 * │ LT4 LT3 LT2 LT1 LT0         │ │         RT0 RT1 RT2 RT3 RT4 │
 * │ LM4 LM3 LM2 LM1 LM0         │ │         RM0 RM1 RM2 RM3 RM4 │
 * │ LB4 LB3 LB2 LB1 LB0         │ │         RB0 RB1 RB2 RB3 RB4 │
 * ╰───────────╮ LH2 LH1 LH0     │ │     RH0 RH1 RH2 ╭───────────╯
 *             ╰─────────────────╯ ╰─────────────────╯
 */

#define KEYS_L 1 2 3 4 5  13 14 15 16 17  25 26 27 28 29   // Left hand keys
#define KEYS_R 6 7 8 9 10  18 19 20 21 22  30 31 32 33 34  // Right hand keys
#define THUMBS 36 37 38 39 40 41                           // All thumbs

/* Timeless homerow mods */
#define MAKE_HRM(NAME, HOLD, TAP, TRIGGER_POS) \
  ZMK_HOLD_TAP(NAME, bindings = <HOLD>, <TAP>; flavor = "balanced"; \
               tapping-term-ms = <280>; quick-tap-ms = <QUICK_TAP_MS>; \
               require-prior-idle-ms = <150>; hold-trigger-on-release; \
               hold-trigger-key-positions = <TRIGGER_POS>;)

MAKE_HRM(hml, &kp, &kp, KEYS_R THUMBS)  // Left-hand HRMs
MAKE_HRM(hmr, &kp, &kp, KEYS_L THUMBS)  // Right-hand HRMs

/* Mouse emulation */
#include "mouse.dtsi"

/* Combos */
#include "combos.dtsi"

/* Leader key sequences */
#include "leader.dtsi"

// Sticky shift + leader
ZMK_MACRO(leader_sft, bindings = <&sk LSHFT &leader>;)

/* Nav cluster hold-taps */
#define MT_CORE \
  flavor = "tap-preferred"; \
  tapping-term-ms = <220>; \
  quick-tap-ms = <220>; \
  hold-trigger-key-positions = <0>;

&mt { MT_CORE };

ZMK_HOLD_TAP(mt_home, bindings = <&masked_home>, <&kp>; MT_CORE)
ZMK_HOLD_TAP(mt_end, bindings = <&masked_end>, <&kp>; MT_CORE)

#define NAV_LEFT  &mt_home 0   LEFT
#define NAV_RIGHT &mt_end 0    RIGHT
#define NAV_UP    &mt LC(HOME) UP
#define NAV_DOWN  &mt LC(END)  DOWN
#define NAV_BSPC  &mt LC(BSPC) BSPC
#define NAV_DEL   &mt LC(DEL)  DEL

#define MASK_MODS(NAME, MODS, BINDING) \
  ZMK_MOD_MORPH(NAME, bindings = <BINDING>, <BINDING>; mods = <MODS>;)

MASK_MODS(masked_home, (MOD_LCTL), &kp HOME)
MASK_MODS(masked_end,  (MOD_LCTL), &kp END)

/* Smart behaviors */

// Tap: num-word | double-tap: sticky num-layer | Hold: num-layer
#define SMART_NUM &smart_num NUM 0
ZMK_HOLD_TAP(smart_num, bindings = <&mo>, <&num_dance>; flavor = "balanced";
             tapping-term-ms = <200>; quick-tap-ms = <QUICK_TAP_MS>;)
ZMK_TAP_DANCE(num_dance, bindings = <&num_word NUM>, <&sl NUM>;
              tapping-term-ms = <200>;)

// Smart-mouse using tri-state
ZMK_TRI_STATE(
    smart_mouse, bindings = <&tog MOUSE>, <&none>, <&tog MOUSE>;
    ignored-key-positions = <LT1 LT2 LH0 LH1 RT1 RT2 RT3 RM0 RM1 RM2 RM3 RM4 RB1 RB2 RB3 RH0 RH1>;
    ignored-layers = <MOUSE NAV FUN>;)

// Tap: sticky shift | Hold: GNUM layer | Tap-tap-hold: hold shift
#define GNUM_SFT &gnum_sft GNUM LSHFT
ZMK_HOLD_TAP(gnum_sft, bindings = <&mo>, <&sk>; flavor = "balanced";
             tapping-term-ms = <200>; quick-tap-ms = <200>;)

/* Mod-morph helper */
#define SIMPLE_MORPH(NAME, MOD, BINDING1, BINDING2) \
  ZMK_MOD_MORPH(NAME, mods = <(MOD_L##MOD | MOD_R##MOD)>; \
                bindings = <BINDING1>, <BINDING2>;)

// Tap: space | Double-tap: sticky shift | Hold: nav layer
#define SMART_SPC &smart_spc NAV 0
ZMK_HOLD_TAP(smart_spc, bindings = <&mo>, <&spc_dance>; flavor = "balanced";
             tapping-term-ms = <200>; quick-tap-ms = <QUICK_TAP_MS>;)
ZMK_TAP_DANCE(spc_dance, bindings = <&kp SPACE>, <&sk LSHFT>;
              tapping-term-ms = <200>;)

// Tap: tab | Double-tap: delete | Hold: Mouse layer
#define SMART_TAB &smart_tab MOUSE 0
ZMK_HOLD_TAP(smart_tab, bindings = <&mo>, <&tab_dance>; flavor = "balanced";
             tapping-term-ms = <200>; quick-tap-ms = <QUICK_TAP_MS>;)
ZMK_TAP_DANCE(tab_dance, bindings = <&kp TAB>, <&kp DEL>;
              tapping-term-ms = <200>;)

// Tap: backspace | Shift + tap: delete
ZMK_MOD_MORPH(bs_del, bindings = <&kp BSPC>, <&kp DEL>;
              mods = <(MOD_LSFT|MOD_RSFT)>; keep-mods = <MOD_RSFT>;)

/* US-International umlauts: tap = lowercase, shift = uppercase
 * ä = RA(Q), ö = RA(P), ü = RA(Y), ß = RA(S), € = RA(N5) */
SIMPLE_MORPH(de_ae, SFT, &kp RA(Q), &kp RA(LS(Q)))  // ä Ä
SIMPLE_MORPH(de_oe, SFT, &kp RA(P), &kp RA(LS(P)))  // ö Ö
SIMPLE_MORPH(de_ue, SFT, &kp RA(Y), &kp RA(LS(Y)))  // ü Ü
SIMPLE_MORPH(de_ss, SFT, &kp RA(S), &kp RA(LS(S)))  // ß ẞ
#define DE_EURO &kp RA(N5)                           // €

/* Misc */
#define CANCEL &kp K_CANCEL

/* Conditional layers */
ZMK_CONDITIONAL_LAYER(sys, FUN NUM, SYS)  // FUN + NUM --> SYS

/* ══════════════════════════════════════════════════════════════════════════
 * KEYMAP - Dvorak layout on 42-key Toucan (outer columns = XXX)
 * ══════════════════════════════════════════════════════════════════════════ */

ZMK_LAYER(Base,
//╭──────┬─────────────┬─────────────┬─────────────┬─────────────┬─────────────╮   ╭─────────────┬─────────────┬─────────────┬─────────────┬─────────────┬──────╮
    XXX    &kp SQT       &kp COMMA     &kp DOT      &kp P         &kp Y              &kp F         &kp G         &kp C         &kp R         &kp L         XXX
//├──────┼─────────────┼─────────────┼─────────────┼─────────────┼─────────────┤   ├─────────────┼─────────────┼─────────────┼─────────────┼─────────────┼──────┤
    XXX    &hml LGUI A   &hml LALT O   &hml LCTRL E  &hml LSHFT U  &kp I              &kp D         &hmr LSHFT H  &hmr LCTRL T  &hmr LALT N   &hmr LGUI S   XXX
//├──────┼─────────────┼─────────────┼─────────────┼─────────────┼─────────────┤   ├─────────────┼─────────────┼─────────────┼─────────────┼─────────────┼──────┤
    XXX    &kp SLASH     &kp Q         &kp J         &kp K         &kp X              &kp B         &kp M         &kp W         &kp V         &kp Z         XXX
//╰──────┴─────────────┴─────────────┼─────────────┼─────────────┼─────────────┤   ├─────────────┼─────────────┼─────────────┼─────────────┴─────────────┴──────╯
                                       &lt INTL ESC  SMART_SPC     SMART_TAB     &lt SYM RET   SMART_NUM     &lt FUN BSPC
//                                   ╰─────────────┴─────────────┴─────────────╯   ╰─────────────┴─────────────┴─────────────╯
)

ZMK_LAYER(Nav,
//╭──────┬─────────────┬─────────────┬─────────────┬─────────────┬─────────────╮   ╭─────────────┬─────────────┬─────────────┬─────────────┬─────────────┬──────╮
    XXX    ___           ___           ___           ___           ___                &kp PG_UP     NAV_BSPC      NAV_UP        CANCEL        ___           XXX
//├──────┼─────────────┼─────────────┼─────────────┼─────────────┼─────────────┤   ├─────────────┼─────────────┼─────────────┼─────────────┼─────────────┼──────┤
    XXX    &sk LGUI      &sk LALT      &sk LCTRL     &sk LSHFT     ___                &kp PG_DN     NAV_LEFT      NAV_DOWN      NAV_RIGHT     &kp TAB       XXX
//├──────┼─────────────┼─────────────┼─────────────┼─────────────┼─────────────┤   ├─────────────┼─────────────┼─────────────┼─────────────┼─────────────┼──────┤
    XXX    ___           ___           ___           ___           ___                &kp INS       NAV_DEL       &kp HOME      &kp END       ___           XXX
//╰──────┴─────────────┴─────────────┼─────────────┼─────────────┼─────────────┤   ├─────────────┼─────────────┼─────────────┼─────────────┴─────────────┴──────╯
                                        ___           ___           ___                &kp RET       NAV_DEL       &kp BSPC
//                                   ╰─────────────┴─────────────┴─────────────╯   ╰─────────────┴─────────────┴─────────────╯
)

ZMK_LAYER(Mouse,
//╭──────┬─────────────┬─────────────┬─────────────┬─────────────┬─────────────╮   ╭─────────────┬─────────────┬─────────────┬─────────────┬─────────────┬──────╮
    XXX    ___           ___           ___           ___           ___                ___           U_WH_L        U_MS_U        U_WH_R        U_WH_U        XXX
//├──────┼─────────────┼─────────────┼─────────────┼─────────────┼─────────────┤   ├─────────────┼─────────────┼─────────────┼─────────────┼─────────────┼──────┤
    XXX    &sk LGUI      &sk LALT      &sk LCTRL     &sk LSHFT     ___                ___           U_MS_L        U_MS_D        U_MS_R        U_WH_D        XXX
//├──────┼─────────────┼─────────────┼─────────────┼─────────────┼─────────────┤   ├─────────────┼─────────────┼─────────────┼─────────────┼─────────────┼──────┤
    XXX    ___           ___           ___           ___           ___                ___           &mkp LCLK     &mkp MCLK     &mkp RCLK     ___           XXX
//╰──────┴─────────────┴─────────────┼─────────────┼─────────────┼─────────────┤   ├─────────────┼─────────────┼─────────────┼─────────────┴─────────────┴──────╯
                                        ___           ___           ___                &mkp LCLK     &mkp MCLK     &mkp RCLK
//                                   ╰─────────────┴─────────────┴─────────────╯   ╰─────────────┴─────────────┴─────────────╯
)

ZMK_LAYER(Media,
//╭──────┬─────────────┬─────────────┬─────────────┬─────────────┬─────────────╮   ╭─────────────┬─────────────┬─────────────┬─────────────┬─────────────┬──────╮
    XXX    ___           ___           ___           ___           ___                ___           ___           &kp C_VOL_UP  ___           ___           XXX
//├──────┼─────────────┼─────────────┼─────────────┼─────────────┼─────────────┤   ├─────────────┼─────────────┼─────────────┼─────────────┼─────────────┼──────┤
    XXX    &sk LGUI      &sk LALT      &sk LCTRL     &sk LSHFT     ___                ___           &kp C_PREV    &kp C_VOL_DN  &kp C_NEXT    ___           XXX
//├──────┼─────────────┼─────────────┼─────────────┼─────────────┼─────────────┤   ├─────────────┼─────────────┼─────────────┼─────────────┼─────────────┼──────┤
    XXX    ___           ___           ___           ___           ___                ___           ___           ___           ___           ___           XXX
//╰──────┴─────────────┴─────────────┼─────────────┼─────────────┼─────────────┤   ├─────────────┼─────────────┼─────────────┼─────────────┴─────────────┴──────╯
                                       ___           ___           ___                &kp C_STOP    &kp C_PP      &kp C_MUTE
//                                   ╰─────────────┴─────────────┴─────────────╯   ╰─────────────┴─────────────┴─────────────╯
)

ZMK_LAYER(Num,
//╭──────┬─────────────┬─────────────┬─────────────┬─────────────┬─────────────╮   ╭─────────────┬─────────────┬─────────────┬─────────────┬─────────────┬──────╮
    XXX    &kp LBKT      &kp N7        &kp N8        &kp N9        &kp RBKT           ___           &sk RSHFT     &sk RCTRL     &sk RALT      &sk RGUI      XXX
//├──────┼─────────────┼─────────────┼─────────────┼─────────────┼─────────────┤   ├─────────────┼─────────────┼─────────────┼─────────────┼─────────────┼──────┤
    XXX    &kp SEMI      &kp N4        &kp N5        &kp N6        &kp EQUAL          &mo NUMPAD    &sk RSHFT     &sk RCTRL     &sk LALT      &sk RGUI      XXX
//├──────┼─────────────┼─────────────┼─────────────┼─────────────┼─────────────┤   ├─────────────┼─────────────┼─────────────┼─────────────┼─────────────┼──────┤
    XXX    &kp GRAVE     &kp N1        &kp N2        &kp N3        &kp BSLH           ___           ___           ___           ___           ___           XXX
//╰──────┴─────────────┴─────────────┼─────────────┼─────────────┼─────────────┤   ├─────────────┼─────────────┼─────────────┼─────────────┴─────────────┴──────╯
                                       &kp DOT       &kp N0        &kp MINUS          ___           ___           ___
//                                   ╰─────────────┴─────────────┴─────────────╯   ╰─────────────┴─────────────┴─────────────╯
)

ZMK_LAYER(Sym,
//╭──────┬─────────────┬─────────────┬─────────────┬─────────────┬─────────────╮   ╭─────────────┬─────────────┬─────────────┬─────────────┬─────────────┬──────╮
    XXX    &kp LBRC      &kp AMPS      &kp STAR      &kp LPAR      &kp RBRC           ___           &sk RSHFT     &sk RCTRL     &sk RALT      &sk RGUI      XXX
//├──────┼─────────────┼─────────────┼─────────────┼─────────────┼─────────────┤   ├─────────────┼─────────────┼─────────────┼─────────────┼─────────────┼──────┤
    XXX    &kp COLON     &kp DLLR      &kp PRCNT     &kp CARET     &kp PLUS           &sl MEDIA     &sk RSHFT     &sk RCTRL     &sk LALT      &sk RGUI      XXX
//├──────┼─────────────┼─────────────┼─────────────┼─────────────┼─────────────┤   ├─────────────┼─────────────┼─────────────┼─────────────┼─────────────┼──────┤
    XXX    &kp TILDE     &kp EXCL      &kp AT        &kp HASH      &kp PIPE           ___           ___           ___           ___           ___           XXX
//╰──────┴─────────────┴─────────────┼─────────────┼─────────────┼─────────────┤   ├─────────────┼─────────────┼─────────────┼─────────────┴─────────────┴──────╯
                                       &kp LPAR      &kp RPAR      &kp UNDER          ___           ___           ___
//                                   ╰─────────────┴─────────────┴─────────────╯   ╰─────────────┴─────────────┴─────────────╯
)

ZMK_LAYER(Fun,
//╭──────┬─────────────┬─────────────┬─────────────┬─────────────┬─────────────╮   ╭─────────────┬─────────────┬─────────────┬─────────────┬─────────────┬──────╮
    XXX    &kp F12       &kp F7        &kp F8        &kp F9        &kp PSCRN          &kp PSCRN     &kp SLCK      &kp CLCK     &kp KP_NLCK    ___           XXX
//├──────┼─────────────┼─────────────┼─────────────┼─────────────┼─────────────┤   ├─────────────┼─────────────┼─────────────┼─────────────┼─────────────┼──────┤
    XXX    &kp F11       &kp F4        &kp F5        &kp F6        &kp SLCK           ___           &sk RSHFT     &sk RCTRL     &sk LALT      &sk RGUI      XXX
//├──────┼─────────────┼─────────────┼─────────────┼─────────────┼─────────────┤   ├─────────────┼─────────────┼─────────────┼─────────────┼─────────────┼──────┤
    XXX    &kp F10       &kp F1        &kp F2        &kp F3     &kp PAUSE_BREAK       &kp K_APP     ___           ___           ___           ___           XXX
//╰──────┴─────────────┴─────────────┼─────────────┼─────────────┼─────────────┤   ├─────────────┼─────────────┼─────────────┼─────────────┴─────────────┴──────╯
                                        &kp K_APP     &kp SPACE     &kp TAB            ___           ___           ___
//                                   ╰─────────────┴─────────────┴─────────────╯   ╰─────────────┴─────────────┴─────────────╯
)

ZMK_LAYER(Intl,
//╭──────┬─────────────┬─────────────┬─────────────┬─────────────┬─────────────╮   ╭─────────────┬─────────────┬─────────────┬─────────────┬─────────────┬──────╮
    XXX    ___           ___           ___           ___           ___                ___           ___           ___           ___           ___           XXX
//├──────┼─────────────┼─────────────┼─────────────┼─────────────┼─────────────┤   ├─────────────┼─────────────┼─────────────┼─────────────┼─────────────┼──────┤
    XXX    &de_ae        &de_oe        DE_EURO       &de_ue        ___                ___           ___           ___           ___           &de_ss        XXX
//├──────┼─────────────┼─────────────┼─────────────┼─────────────┼─────────────┤   ├─────────────┼─────────────┼─────────────┼─────────────┼─────────────┼──────┤
    XXX    ___           ___           ___           ___           ___                ___           ___           ___           ___           ___           XXX
//╰──────┴─────────────┴─────────────┼─────────────┼─────────────┼─────────────┤   ├─────────────┼─────────────┼─────────────┼─────────────┴─────────────┴──────╯
                                       ___           ___           ___                ___           ___           ___
//                                   ╰─────────────┴─────────────┴─────────────╯   ╰─────────────┴─────────────┴─────────────╯
)

ZMK_LAYER(Qwerty,
//╭──────┬─────────────┬─────────────┬─────────────┬─────────────┬─────────────╮   ╭─────────────┬─────────────┬─────────────┬─────────────┬─────────────┬──────╮
    XXX    &kp Q         &kp W         &kp E         &kp R         &kp T              &kp Y         &kp U         &kp I         &kp O         &kp P         XXX
//├──────┼─────────────┼─────────────┼─────────────┼─────────────┼─────────────┤   ├─────────────┼─────────────┼─────────────┼─────────────┼─────────────┼──────┤
    XXX    &hml LGUI A   &hml LALT S   &hml LCTRL D  &hml LSHFT F  &kp G              &kp H         &hmr LSHFT J  &hmr LCTRL K  &hmr LALT L   &hmr LGUI SEMI XXX
//├──────┼─────────────┼─────────────┼─────────────┼─────────────┼─────────────┤   ├─────────────┼─────────────┼─────────────┼─────────────┼─────────────┼──────┤
    XXX    &kp Z         &kp X         &kp C         &kp V         &kp B              &kp N         &kp M         &kp COMMA     &kp DOT       &kp SLASH     XXX
//╰──────┴─────────────┴─────────────┼─────────────┼─────────────┼─────────────┤   ├─────────────┼─────────────┼─────────────┼─────────────┴─────────────┴──────╯
                                       &lt INTL ESC  SMART_SPC     SMART_TAB     &lt SYM RET   SMART_NUM     &lt FUN BSPC
//                                   ╰─────────────┴─────────────┴─────────────╯   ╰─────────────┴─────────────┴─────────────╯
)

ZMK_LAYER(Game,
//╭──────┬─────────────┬─────────────┬─────────────┬─────────────┬─────────────╮   ╭─────────────┬─────────────┬─────────────┬─────────────┬─────────────┬──────╮
    XXX    &kp Q         &kp W         &kp E         &kp R         &kp T              &kp Y         &kp U         &kp I         &kp O         &kp P         XXX
//├──────┼─────────────┼─────────────┼─────────────┼─────────────┼─────────────┤   ├─────────────┼─────────────┼─────────────┼─────────────┼─────────────┼──────┤
    XXX    &kp A         &kp S         &kp D         &kp F         &kp G              &kp H         &kp J         &kp K         &kp L         &kp SEMI      XXX
//├──────┼─────────────┼─────────────┼─────────────┼─────────────┼─────────────┤   ├─────────────┼─────────────┼─────────────┼─────────────┼─────────────┼──────┤
    XXX    &kp Z         &kp X         &kp C         &kp V         &kp B              &kp N         &kp M         &kp COMMA     &kp DOT       &kp SLASH     XXX
//╰──────┴─────────────┴─────────────┼─────────────┼─────────────┼─────────────┤   ├─────────────┼─────────────┼─────────────┼─────────────┴─────────────┴──────╯
                                       &kp LCTRL     &kp SPACE     GNUM_SFT           &lt SYM RET   SMART_NUM     &lt FUN BSPC
//                                   ╰─────────────┴─────────────┴─────────────╯   ╰─────────────┴─────────────┴─────────────╯
)

ZMK_LAYER(Gnum,
//╭──────┬─────────────┬─────────────┬─────────────┬─────────────┬─────────────╮   ╭─────────────┬─────────────┬─────────────┬─────────────┬─────────────┬──────╮
    XXX    &kp N1        &kp N2        &kp N3        &kp N4        &kp N5             &kp N6        &kp N7        &kp N8        &kp N9        &kp N0        XXX
//├──────┼─────────────┼─────────────┼─────────────┼─────────────┼─────────────┤   ├─────────────┼─────────────┼─────────────┼─────────────┼─────────────┼──────┤
    XXX    &kp ESC       &kp CLCK      &kp TAB       &kp LALT      &kp LSHFT          &kp F6        &kp F7        &kp F8        &kp F9        &kp F10       XXX
//├──────┼─────────────┼─────────────┼─────────────┼─────────────┼─────────────┤   ├─────────────┼─────────────┼─────────────┼─────────────┼─────────────┼──────┤
    XXX    &kp F1        &kp F2        &kp F3        &kp F4        &kp F5             &kp F11       &kp F12       ___           ___           ___           XXX
//╰──────┴─────────────┴─────────────┼─────────────┼─────────────┼─────────────┤   ├─────────────┼─────────────┼─────────────┼─────────────┴─────────────┴──────╯
                                       ___           ___           ___                ___           ___           ___
//                                   ╰─────────────┴─────────────┴─────────────╯   ╰─────────────┴─────────────┴─────────────╯
)

ZMK_LAYER(Numpad,
//╭──────┬─────────────┬─────────────┬─────────────┬─────────────┬─────────────╮   ╭─────────────┬─────────────┬─────────────┬─────────────┬─────────────┬──────╮
    XXX    &kp KP_NLCK   &kp KP_N7     &kp KP_N8     &kp KP_N9     &kp KP_SLASH       ___           ___           ___           ___           ___           XXX
//├──────┼─────────────┼─────────────┼─────────────┼─────────────┼─────────────┤   ├─────────────┼─────────────┼─────────────┼─────────────┼─────────────┼──────┤
    XXX    &kp KP_ENTER  &kp KP_N4     &kp KP_N5     &kp KP_N6     &kp KP_ASTERISK    ___           ___           ___           ___           ___           XXX
//├──────┼─────────────┼─────────────┼─────────────┼─────────────┼─────────────┤   ├─────────────┼─────────────┼─────────────┼─────────────┼─────────────┼──────┤
    XXX    &kp KP_PLUS   &kp KP_N1     &kp KP_N2     &kp KP_N3     &kp KP_MINUS       ___           ___           ___           ___           ___           XXX
//╰──────┴─────────────┴─────────────┼─────────────┼─────────────┼─────────────┤   ├─────────────┼─────────────┼─────────────┼─────────────┴─────────────┴──────╯
                                        &kp KP_DOT    &kp KP_N0     &kp KP_ENTER       ___           ___           ___
//                                   ╰─────────────┴─────────────┴─────────────╯   ╰─────────────┴─────────────┴─────────────╯
)

ZMK_LAYER(Sys,
//╭──────┬─────────────┬─────────────┬─────────────┬─────────────┬─────────────╮   ╭─────────────┬─────────────┬─────────────┬─────────────┬─────────────┬──────╮
    XXX    &bootloader   ___           ___           ___           ___                &to BASE      &to QWERTY    &to GAME      ___           &bootloader   XXX
//├──────┼─────────────┼─────────────┼─────────────┼─────────────┼─────────────┤   ├─────────────┼─────────────┼─────────────┼─────────────┼─────────────┼──────┤
    XXX    &bt BT_SEL 0  &bt BT_SEL 1  &bt BT_SEL 2  &bt BT_SEL 3  &bt BT_SEL 4        ___           ___           ___           ___           ___           XXX
//├──────┼─────────────┼─────────────┼─────────────┼─────────────┼─────────────┤   ├─────────────┼─────────────┼─────────────┼─────────────┼─────────────┼──────┤
    XXX    &sys_reset    ___           ___           ___           &bt BT_CLR          ___           ___           ___           ___           &sys_reset    XXX
//╰──────┴─────────────┴─────────────┼─────────────┼─────────────┼─────────────┤   ├─────────────┼─────────────┼─────────────┼─────────────┴─────────────┴──────╯
                                        ___           ___           ___                ___           ___           ___
//                                   ╰─────────────┴─────────────┴─────────────╯   ╰─────────────┴─────────────┴─────────────╯
)

/* vim: set ft=dts tw=174: */
