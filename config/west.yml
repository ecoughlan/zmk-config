## config/west.yml
```yaml
# West manifest for Toucan ZMK configuration
# Merges: ZMK core, Toucan shield, urob's modules, Cirque trackpad support
---
manifest:
  defaults:
    remote: urob
    revision: main

  remotes:
    - name: zmkfirmware
      url-base: https://github.com/zmkfirmware
    - name: urob
      url-base: https://github.com/urob
    - name: ecoughlan
      url-base: https://github.com/ecoughlan

  projects:
    # Core ZMK - main branch for ZMK Studio and latest features
    - name: zmk
      remote: zmkfirmware
      revision: main
      import: app/west.yml

    # Toucan shield definitions (fork with LVGL v9 fixes)
    - name: zmk-keyboard-toucan
      remote: ecoughlan
      revision: lvgl-v9

    # Note: Cirque trackpad support is now built into ZMK main

    # urob's ZMK modules for advanced behaviors
    - name: zmk-helpers
      path: modules/zmk/helpers
    - name: zmk-auto-layer
      path: modules/zmk/auto-layer
    - name: zmk-tri-state
      path: modules/zmk/tri-state
    - name: zmk-leader-key
      path: modules/zmk/leader-key
    - name: zmk-unicode
      path: modules/zmk/unicode

  self:
    path: config
```
